/dts-v1/;
/plugin/;

/ {
	compatible = "allwinner,sun8i-h3";

	fragment@0 {
		target = <&i2c1>;
		__overlay__ {
			#address-cells = <1>;
			#size-cells = <0>;
			bme280@77 {
				compatible = "bosch,bme280";
				reg = <0x77>;
			};
		};
	};
};
