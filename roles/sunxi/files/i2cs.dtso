/dts-v1/;
/plugin/;

/ {
	compatible = "allwinner,sun8i-h3";

	fragment@0 {
		target-path = "/aliases";
		__overlay__ {
			i2c0 = <&i2c0>;
			i2c1 = <&i2c1>;
		};
	};

	fragment@1 {
		target = <&i2c0>;
		__overlay__ {
			status = "okay";
		};
	};

	fragment@2 {
		target = <&i2c1>;
		__overlay__ {
			status = "okay";
		};
	};
};
